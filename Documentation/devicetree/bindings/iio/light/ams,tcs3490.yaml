## Documentation/devicetree/bindings/iio/light/ams,tcs3490.yaml
```yaml
# SPDX-License-Identifier: GPL-2.0-only OR BSD-2-Clause
%YAML 1.2
---
$id: http://devicetree.org/schemas/iio/light/ams,tcs3490.yaml#
$schema: http://devicetree.org/meta-schemas/core.yaml#

title: AMS TCS3490 Color Light-to-Digital Converter

maintainers:
  - Markuss Broks <markuss.broks@gmail.com>

description: |
  Color and IR light sensor typically used to adjust the backlight intensity and correct the display
  color gamut. Additionally can be used for light source type detection as it reports the IR content
  of the light.

properties:
  compatible:
    enum:
      - ams,tcs3490

  reg:
    description:
      I2C address of the device (typically 0x39).
    maxItems: 1

  vdd-supply: true

required:
  - compatible
  - reg
  - vdd-supply

additionalProperties: false

examples:
  - |
    #include <dt-bindings/interrupt-controller/irq.h>

    i2c {
        #address-cells = <1>;
        #size-cells = <0>;

        light@39 {
            compatible = "ams,tcs3490";
            reg = <0x39>;
            vdd-supply = <&cam_vio_vreg>;
        };
    };
...
```
